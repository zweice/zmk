## app/dts/bindings/behaviors/zmk,behavior-kb-clock.yaml
```yaml
# SPDX-License-Identifier: MIT

description: Keyboard wall clock (type / set) and deep-vs-light sleep switch

compatible: "zmk,behavior-kb-clock"

include: one_param.yaml
```

## app/dts/bindings/behaviors/zmk,behavior-keep-awake.yaml
```yaml
# SPDX-License-Identifier: MIT

description: Keep-awake - periodically taps an unused key so the host never idles

compatible: "zmk,behavior-keep-awake"

include: one_param.yaml

properties:
  keycode:
    type: int
    default: 0x73
    description: HID keyboard usage id to tap (default F24)
  interval-ms:
    type: int
    default: 30000
```

## app/dts/bindings/behaviors/zmk,behavior-status-info.yaml
```yaml
# SPDX-License-Identifier: MIT

description: Types a one-line status report (battery, connection, uptime, keep-awake)

compatible: "zmk,behavior-status-info"

include: zero_param.yaml
```
