/*
 * SPDX-License-Identifier: MIT
 */

#include <dt-bindings/zmk/kb_clock.h>

/ {
    behaviors {
        /omit-if-no-ref/ kb_clock: behavior_kb_clock {
            compatible = "zmk,behavior-kb-clock";
            label = "KB_CLOCK";
            #binding-cells = <1>;
        };
    };
};
