/*
 * SPDX-License-Identifier: MIT
 */

#include <dt-bindings/zmk/hid_usage.h>
#include <dt-bindings/zmk/keep_awake.h>

/ {
    behaviors {
        /omit-if-no-ref/ keep_awake: behavior_keep_awake {
            compatible = "zmk,behavior-keep-awake";
            label = "KEEP_AWAKE";
            #binding-cells = <1>;
            keycode = <HID_USAGE_KEY_KEYBOARD_F24>;
            interval-ms = <30000>;
        };
    };
};
